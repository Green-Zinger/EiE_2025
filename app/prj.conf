## prj.conf
```kconfig
# Copyright (c) 2021 Nordic Semiconductor ASA
# SPDX-License-Identifier: Apache-2.0
#
# This file contains selected Kconfig options for the application.

CONFIG_GPIO=y
CONFIG_PWM=y
CONFIG_SMF=y
CONFIG_SYSTEM_WORKQUEUE_STACK_SIZE=2048
CONFIG_BT=y
CONFIG_BT_PERIPHERAL=y
CONFIG_BT_DEVICE_NAME="3017 EiE BLE Peripheral"
```

## src/main.c
```c
/*
 * main.c
 */

#include <zephyr/kernel.h>
#include <zephyr/device.h>
#include <zephyr/drivers/gpio.h>
#include <zephyr/sys/printk.h>
#include <inttypes.h>
#include "BTN.h"
#include "LED.h"

#define SLEEP_TIME_MS 1

#define INPUT_BASE_LENGTH 4

int* variable_int_input(int *length);
//REQUIRES:
//BUTTON and LED input are set up. Length point to a valid memory address of integer type.
//PROMISES:
//the return value is a pointer to array of ints that represent a sequence of button presses,
//inputed by the user.

int main(void){
    if(0>BTN_init()){
        printk("Failure setting up BTN");
        return 0;
    }

    if(0>LED_init()){
        printk("Failure setting up LED");
        return 0;
    }
    
    //Setting up intial conditions for input.
    int input_length;
    int *input;
    int sleep; 

    //Setting up the initial conditions for password setting.
    int password_length=INPUT_BASE_LENGTH;
    int default_password[INPUT_BASE_LENGTH] = {0, 1, 1, 2};
    int *password = default_password;

    LED_toggle(LED3);
    for(int i = 0; i<3000; i++){
        if(BTN_check_clear_pressed(BTN3)){
                LED_toggle(LED3);
                printk("Choose a password.\n");
                password = variable_int_input(&password_length);
                break;
        }
        k_msleep(SLEEP_TIME_MS);
    }
    //The main loop
    while(1){
        sleep = 1;
        printk("What is the password?\n");
        input = variable_int_input(&input_length);

        if(input_length != password_length){
            printk("Incorrect! You Suck! Wrong length! %d is not equal to %d\n", password_length, input_length);   
        }else{
            int i;
            for(i = 0; i<INPUT_BASE_LENGTH; i++){
                if(input[i] != password[i]){
                    printk("Incorrect! You Suck! Only got the length right!\n");
                    break;
                }
            }
            if(i == INPUT_BASE_LENGTH)
                printk("Correct! You are the Goat!\n");
        }
        
        k_free(input);
        //This is the waiting state.
        while(sleep){
            if(BTN_check_clear_pressed(BTN0)){
                sleep = 0;
            }else if(BTN_check_clear_pressed(BTN1)){
                sleep = 0;
            }else if(BTN_check_clear_pressed(BTN2)){
                sleep = 0;
            }else if(BTN_check_clear_pressed(BTN3)){
                sleep = 0;
            }
            k_msleep(SLEEP_TIME_MS);
        }
    }

    return 0;
}
int* variable_int_input(int *length){
    //Gotta enable dynamic memory to use value the way it is being used.
    int cap = INPUT_BASE_LENGTH;
    *length = 0;
    int *arr = k_malloc(cap*sizeof(int));
    int entry = 1;
    if(arr == NULL){
        printk("Memory error.\n");
        return 0;
    }
    printk("Please input your button sequence now:\n\n\n");
    LED_toggle(LED0);
    //locked state loop
    while(entry){
        if(*length==cap){
            int *old = arr;
            arr = k_malloc(cap*2*sizeof(int));

            if(arr == NULL)
                return 0;

            for(int i =0; i<cap; i++)
                arr[i] = old[i];

            cap*=2;
            k_free(old);
            }
        while(1){
            if(BTN_check_clear_pressed(BTN0)){
                arr[*length] = 0;
                (*length)++;
                printk("input number:%d\n",*length);
                break;
            }else if(BTN_check_clear_pressed(BTN1)){
                arr[*length] = 1;
                (*length)++;
                printk("input number:%d\n",*length);
                break;
            }else if(BTN_check_clear_pressed(BTN2)){
                arr[*length] = 2;
                (*length)++;
                printk("input number:%d\n",*length);
                break;
            }else if(BTN_check_clear_pressed(BTN3)){
                entry = 0;
                break;
            }
            k_msleep(SLEEP_TIME_MS);
        }
            
    }
    LED_toggle(LED0);
    return arr;
}
```

## src/my_state_machine.c
```c
/**
 * @file my_state_machine.c
 */

 #include <zephyr/smf.h>

 #include "LED.h"
 #include "BTN.h"
 #include "my_state_machine.h"

/*----------------------------------------
* Function Prototypes
------------------------------------------*/
static void state_0_entry(void* o);
static enum smf_state_result state_0_run(void* o);
static void state_1_entry(void* o);
static enum smf_state_result state_1_run(void* o);
static void state_2_entry(void* o);
static enum smf_state_result state_2_run(void* o);
static void state_3_entry(void* o);
static enum smf_state_result state_3_run(void* o);
static void state_4_entry(void* o);
static enum smf_state_result state_4_run(void* o);
/*--------------------------------------
* Typedefs
------------------------------------------*/
enum state_machine_states{
    STATE_0,
    STATE_1,
    STATE_2,
    STATE_3,
    STATE_4
};

typedef struct {
    //Context variable used by zephyr to track state machine state. Must be first
    struct smf_ctx ctx;

    uint16_t count;
} state_object_t;
/*--------------------------------------
* Local Variables
------------------------------------------*/
static const struct smf_state states[] = {
    [STATE_0] = SMF_CREATE_STATE(state_0_entry, state_0_run, NULL, NULL, NULL),
    [STATE_1] = SMF_CREATE_STATE(state_1_entry, state_1_run, NULL, NULL, NULL),
    [STATE_2] = SMF_CREATE_STATE(state_2_entry, state_2_run, NULL, NULL, NULL),
    [STATE_3] = SMF_CREATE_STATE(state_3_entry, state_3_run, NULL, NULL, NULL),
    [STATE_4] = SMF_CREATE_STATE(state_4_entry, state_4_run, NULL, NULL, NULL)
};
static state_object_t state_object;

 void state_machine_init(){
    state_object.count = 0;
    smf_set_initial(SMF_CTX(&state_object), &states[STATE_0]);
 }

 int state_machine_run(){
    return smf_run_state(SMF_CTX(&state_object));
 }
 
 static void state_0_entry(void* o){
    LED_set(LED0, LED_OFF);
    LED_set(LED1, LED_OFF);
    LED_set(LED2, LED_OFF);
    LED_set(LED3, LED_OFF);
 }
 
 static enum smf_state_result state_0_run(void* o){
    if(BTN_check_clear_pressed(BTN0)){
        smf_set_state(SMF_CTX(&state_object), &states[STATE_1]);
    } 
    return SMF_EVENT_HANDLED;
 }
 
 static void state_1_entry(void* o){
    LED_blink(LED0,4);
 }
 static enum smf_state_result state_1_run(void* o){
    if(BTN_check_clear_pressed(BTN1)){
        smf_set_state(SMF_CTX(&state_object), &states[STATE_2]);
    }else if(BTN_check_clear_pressed(BTN2)){
        smf_set_state(SMF_CTX(&state_object), &states[STATE_4]);
    }else if(BTN_check_clear_pressed(BTN3)){
        smf_set_state(SMF_CTX(&state_object), &states[STATE_0]);
    }
    return SMF_EVENT_HANDLED;
 }
 static void state_2_entry(void* o){
    LED_set(LED0, LED_ON);
    LED_set(LED2, LED_ON);
    LED_set(LED1, LED_OFF);
    LED_set(LED3, LED_OFF);
 } 
 static enum smf_state_result state_2_run(void* o){
    if(state_object.count > 1000){
      state_object.count=0;
      smf_set_state(SMF_CTX(&state_object), &states[STATE_3]);  
    }else if(BTN_check_clear_pressed(BTN3)){
      state_object.count=0;
      smf_set_state(SMF_CTX(&state_object), &states[STATE_0]);
    }else{
      state_object.count++;
    }
    return SMF_EVENT_HANDLED;
 }
 
 static void state_3_entry(void* o){
    LED_set(LED0, LED_OFF);
    LED_set(LED2, LED_OFF);
    LED_set(LED1, LED_ON);
    LED_set(LED3, LED_ON);  
 }
 static enum smf_state_result state_3_run(void* o){
    if(state_object.count > 2000){
      state_object.count=0;
      smf_set_state(SMF_CTX(&state_object), &states[STATE_2]); 
    }else if(BTN_check_clear_pressed(BTN3)){
      state_object.count=0;
      smf_set_state(SMF_CTX(&state_object), &states[STATE_0]);
    }else{
      state_object.count++;
    }
    return SMF_EVENT_HANDLED;
 }
 static void state_4_entry(void* o){
    LED_blink(LED0,16);
    LED_blink(LED1,16);
    LED_blink(LED2,16);
    LED_blink(LED3,16);
 }
 static enum smf_state_result state_4_run(void* o){
    if(BTN_check_clear_pressed(BTN3)){
      smf_set_state(SMF_CTX(&state_object), &states[STATE_0]);
    }
    return SMF_EVENT_HANDLED;
 }
```

## src/my_state_machine.h
```c
/**
 * @file my_state_machine.h
 */

 #ifndef MY_STATE_MACHINE_H
 #define MY_STATE_MACHINE_H

void state_machine_init();

int state_machine_run();

#endif //MY_STATE_MACHINE_H
```
